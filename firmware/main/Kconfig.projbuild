## firmware/main/Kconfig.projbuild
```kconfig
menu "go-dock"

config DOCK_THREE_ROWS
    bool "Show 3 tasks per page (larger text) instead of 4"
    default n
    help
        Four rows match the default design. Three rows use larger type,
        which can be easier to read from a distance on the 2.41" panel.

endmenu
```
